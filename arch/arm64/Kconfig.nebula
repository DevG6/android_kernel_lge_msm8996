## arch/arm64/Kconfig.nebula
```kconfig
comment "Nebula Debugging Features"
menuconfig NEBULA_DEBUG
	bool "NEBULA Debugging Feature Switch"
	default n
	help
	  Enable collection of debug features.
	  This feature is enabled in defconfig.
```

## arch/arm64/configs/lge_msm8996_defconfig
```kconfig
include msm-perf_defconfig
# LG Platform
CONFIG_MACH_LGE=y

# ARM
CONFIG_PROC_PID_CPUSET=y

# CPU
CONFIG_CPU_FREQ_DEFAULT_GOV_SCHEDUTIL=y
CONFIG_FAIR_GROUP_SCHED=y
CONFIG_MSM_IDLE_STATS=y
CONFIG_MSM_IDLE_STATS_FIRST_BUCKET=62500
CONFIG_MSM_IDLE_STATS_BUCKET_SHIFT=2
CONFIG_MSM_IDLE_STATS_BUCKET_COUNT=10
CONFIG_MSM_SUSPEND_STATS_FIRST_BUCKET=1000000000

# Broadcom - Bluetooth
CONFIG_BT_BCM43XX=y
CONFIG_BT_MSM_SLEEP=y

# Fingerprint Cards
CONFIG_INPUT_FINGERPRINT=y
CONFIG_INPUT_FINGERPRINT_FPC1020=y

# NXP
CONFIG_NFC=y
CONFIG_NFC_PN548=y

# Other
CONFIG_PSTORE=y
CONFIG_PSTORE_CONSOLE=y
CONFIG_PSTORE_PMSG=y
CONFIG_PSTORE_RAM=y
CONFIG_IOSCHED_BFQ=y
CONFIG_CGROUP_BFQIO=y
CONFIG_LGE_HANDLE_PANIC=y
CONFIG_LGE_HALL_IC=y
CONFIG_SERIAL_MSM_HSL=y
CONFIG_SERIAL_MSM_HSL_CONSOLE=y
CONFIG_EXT4_FS_ENCRYPTION=y

# DOS/FAT/NT Filesystems
CONFIG_SDFAT_FS=y
CONFIG_SDFAT_USE_FOR_EXFAT=y
CONFIG_SDFAT_USE_FOR_VFAT=n
CONFIG_SDFAT_DELAYED_META_DIRTY=y
CONFIG_SDFAT_SUPPORT_DIR_SYNC=y
CONFIG_SDFAT_DEFAULT_CODEPAGE=437
CONFIG_SDFAT_DEFAULT_IOCHARSET="utf8"
CONFIG_SDFAT_CHECK_RO_ATTR=y
CONFIG_SDFAT_ALIGNED_MPAGE_WRITE=y
CONFIG_SDFAT_VIRTUAL_XATTR=y
CONFIG_SDFAT_VIRTUAL_XATTR_SELINUX_LABEL="u:object_r:sdcard_external:s0"
CONFIG_SDFAT_DEBUG=n
CONFIG_SDFAT_SUPPORT_STLOG=y
CONFIG_SDFAT_STATISTICS=y

# Treble
#CONFIG_CP15_BARRIER_EMULATION=y
#CONFIG_SETEND_EMULATION=y
#CONFIG_SECURITY_PERF_EVENTS_RESTRICT=y

# Disable QCOM drivers to avoid confliction
#CONFIG_BT_RFCOMM=n
#CONFIG_MSM_BT_POWER=n
#CONFIG_NFC_NQ=n
#CONFIG_CNSS=n
#CONFIG_USELIB=n

# rcu
CONFIG_RCU_FAST_NO_HZ=y
CONFIG_RCU_BOOST=y
CONFIG_RCU_NOCB_CPU=y
CONFIG_RCU_NOCB_CPU_ALL=y
CONFIG_RCU_CPU_STALL_TIMEOUT=21
CONFIG_RCU_KTHREAD_PRIO=1

# zram
CONFIG_ZRAM=y
CONFIG_CRYPTO_LZ4=y
CONFIG_CRYPTO_LZ4HC=y
CONFIG_LZ4_COMPRESS=y
CONFIG_LZ4_DECOMPRESS=y

# Nebula debugger tools imported from HTC
CONFIG_NEBULA_DEBUG=y
CONFIG_NEBULA_HELPER_FUNCTIONS=y
CONFIG_NEBULA_DEBUG_RAMOOPS=y
CONFIG_NEBULA_DEBUG_RESTART_TIMER=y
CONFIG_NEBULA_REBOOT_BLOCK=y
CONFIG_NEBULA_DEBUG_PAGE_ENTRIES_NR=4
CONFIG_PRINTK_CPU_ID=y
CONFIG_PRINTK_PID=y
# CONFIG_NEBULA_DEBUG_KP is not set
# CONFIG_NEBULA_DEBUG_WATCHDOG is not set
# CONFIG_NEBULA_DEBUG_WORKQUEUE is not set
CONFIG_NEBULA_DEBUG_BOOTLOADER_LOG=y
# CONFIG_NEBULA_NC_GPIO_PIN_SETTING is not set
CONFIG_NEBULA_DEBUG_SAVE_BOOT_MSG=y
# CONFIG_NEBULA_DEBUG_VMALLOC_DUMP is not set
# CONFIG_NEBULA_DEBUG_DYING_PROCS is not set
# CONFIG_NEBULA_PROCESS_DEBUG is not set

#
# Unprivileged Configuration Interface
#
CONFIG_UCI=y

# Added By Me
CONFIG_SOUND_CONTROL=y
# CONFIG_MSM_PRESERVE_MEM is not set

# Compile Modules Staticlally
CONFIG_BRIDGE_NETFILTER=y
CONFIG_SCSI_UFS_TEST=n
CONFIG_LCD_CLASS_DEVICE=y
CONFIG_MMC_BLOCK_TEST=n
CONFIG_CRYPTO_ANSI_CPRNG=y
CONFIG_IOSCHED_TEST=n
CONFIG_BACKLIGHT_CLASS_DEVICE=y

CONFIG_CPUFREQ_DT=y
```

## drivers/nebula_debug/stability/Kconfig
```kconfig
#
# NEBULA_DEBUG stability Kconfig
#

config NEBULA_HELPER_FUNCTIONS
	bool "NEBULA helper functions"
	depends on NEBULA_DEBUG
	default n
	help
	  Extract debug flag from kernel cmdline and define read-only
	  functions to global kernel space

config NEBULA_DEBUG_RAMOOPS
	bool "Log panic/oops to a RAM buffer"
	default n
	depends on PSTORE_CONSOLE
	help
	  This enables panic and oops messages to be logged to a circular
	  buffer in RAM where it can be read back at some later point.

config NEBULA_EARLY_RTB
       bool "NEBULA debug feature for enabling RTB before driver is initial"
       default y
       depends on MSM_RTB && NEBULA_DEBUG && OF && OF_ADDRESS
       help
         This option enables the RTB mechanism before RTB driver is brought up.
         The RTB Log buffer start-address and buffer-size is defined by device-tree.

config NEBULA_DEBUG_RESTART_TIMER
	bool "add a timer in restart notifier chain"
	default y
	depends on NEBULA_DEBUG

config NEBULA_REBOOT_BLOCK
	bool "Store reboot reason / msg ...etc. in IMEM or storage"
	default n
	help
	  Say Y here if you want the NEBULA Reboot Block features

config NEBULA_DEBUG_PAGE_USER_TRACE
	bool "Record call trace of page user in page structure"
	depends on PAGE_POISONING
	default n
	help
	  For debugging purpose, add call trace of user (freer and
	  allocator) to page structure

config NEBULA_DEBUG_PAGE_ENTRIES_NR
	int
	default 4

config PRINTK_CPU_ID
	depends on PRINTK
	default y
	bool "Enable support for Print working core no. in dmesg" if EXPERT
	help
	  Print working CPU number in the dmesg as default, it can be turned
	  off by writing 0 to module parameter cpu.

config PRINTK_PID
	depends on PRINTK
	default y
	bool "Enable support for Print working task id in dmesg" if EXPERT
	help
	  Print working process id in the dmesg as default, it can be turned
	  off by writing 0 to module parameter pid.

config SLUB_LIGHT_WEIGHT_DEBUG_ON
	bool "SLUB light weight debugging on by default"
	depends on SLUB && SLUB_DEBUG && SLUB_DEBUG_ON && !KMEMCHECK
	default n
	help
	  Light weight memory corruption debugging for slub. Only
	  SLAB_DEBUG_FREE was choosen.

config NEBULA_DEBUG_KP
	default n
	depends on NEBULA_DEBUG
	bool "NEBULA style kernel panic debug features"
	help
	  Say Y here if you want the NEBULA style kernel panic debug features

config NEBULA_DEBUG_WATCHDOG
	bool "NEBULA style watchdog debug features"
	depends on NEBULA_DEBUG && MSM_WATCHDOG_V2
	default n
	help
	  Say Y here if you want the NEBULA style watchdog debug features

config NEBULA_DEBUG_WORKQUEUE
	bool "NEBULA style workqueue debug features"
	depends on NEBULA_DEBUG
	default n
	help
	  Say Y here if you want the NEBULA style workqueue debug features

config NEBULA_DEBUG_BOOTLOADER_LOG
	bool "NEBULA style ram console debug features"
	default n
	depends on PSTORE_CONSOLE && NEBULA_DEBUG_RAMOOPS
	help
	  Say Y here if you want the NEBULA style ram console debug features

config NEBULA_NC_GPIO_PIN_SETTING
	bool "NEBULA style nc pin setting features"
	default n
	help
	  Say Y here if you want the NEBULA style nc pin setting features

config NEBULA_DEBUG_SAVE_BOOT_MSG
	default n
	depends on NEBULA_DEBUG
	bool "NEBULA debug: saving kernel log of booting to memory"

config NEBULA_DEBUG_VMALLOC_DUMP
	bool "NEBULA style vmalloc fail debug features"
	depends on NEBULA_DEBUG
	default n
	help
	  This option enables the dump for vmalloc info when vmalloc failed.
	  The same information could also be get under /proc/vmallocinfo

config NEBULA_DEBUG_DYING_PROCS
	bool "NEBULA debug feature for recording dying processes"
	default n
	help
	  This option enables the recording of latest 10 killed processes in
	  /proc/dying_processes

config NEBULA_PROCESS_DEBUG
	bool "process/thread debug support"
	default n
	help
	  This option enables kernel debug log to check if any
	  assigned process receives signal or unexpected exit
```
